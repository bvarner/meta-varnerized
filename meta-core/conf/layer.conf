## meta-core/conf/layer.conf
```bitbake
# meta-core - A varnerized core layer with conf and classes.
BBPATH .= ":${LAYERDIR}"

# Add recipes and images
BBFILES += "${LAYERDIR}/recipes*/*/*.bb \
            ${LAYERDIR}/recipes*/*/*.bbappend \
            ${LAYERDIR}/images/*.bb \
            ${LAYERDIR}/images/*.bbappend"

BBFILE_COLLECTIONS += "varnerized-core"
BBFILE_PATTERN_varnerized-core := "^${LAYERDIR}/"
BBFILE_PRIORITY_varnerized-core = "8"

LAYERVERSION_varnerized-core-layer = "1"
LAYERDEPENDS_varnerized-core-layer = "openembedded-core"

LAYERSERIES_COMPAT_varnerized-core-layer = "gatesgarth"
```

## meta-forfunQ88/conf/layer.conf
```bitbake
BBPATH .= ":${LAYERDIR}"

BBFILES += "${LAYERDIR}/recipes*/*/*.bb \
            ${LAYERDIR}/recipes*/*/*.bbappend \
            ${LAYERDIR}/images/*.bb \
            ${LAYERDIR}/images/*.bbappend "

BBFILE_COLLECTIONS += "varnerized-forfunQ88"
BBFILE_PATTERN_varnerized-forfunQ88 := "^{LAYERDIR}/"
BBFILE_PRIORITY_varnerized-forfunQ88 = "8"

LAYERSERIES_COMPAT_varnerized-forfunQ88 = "gatesgarth"
LAYERDEPENDS_varnerized-forfunQ88 = "meta-sunxi"
```

## meta-forfunQ88/conf/machine/forfun-q88-tablet.conf
```bitbake
#@TYPE: Machine
#@NAME: Q8 A13 MID
#@DESCRIPTION: Machine configuration for A starndard Q8 style tablet device based on allwinner a13 CPU
#https://linux-sunxi.org/Forfun_Q88DB

require conf/machine/include/sun5i.inc

KERNEL_DEVICETREE = "sun5i-a13-q8-tablet.dtb"
UBOOT_MACHINE = "q8_a13_tablet_defconfig"
```

## meta-garagedoor/conf/layer.conf
```bitbake
# We have a conf and classes directory, append to BBPATH
BBPATH .= ":${LAYERDIR}"

# We have a recipes directory containing .bb and .bbappend files, add to BBFILES
BBFILES += "${LAYERDIR}/recipes*/*/*.bb \
            ${LAYERDIR}/recipes*/*/*.bbappend \
            ${LAYERDIR}/images/*.bb \
            ${LAYERDIR}/images/*.bbappend"

BBFILE_COLLECTIONS += "varnerized-garagedoor"
BBFILE_PATTERN_varnerized-garagedoor := "^${LAYERDIR}/"
BBFILE_PRIORITY_varnerized-garagedoor = "11"


LAYERSERIES_COMPAT_varnerized-garagedoor  = "gatesgarth"
LAYERDEPENDS_varnerized-garagedoor = "varnerized-raspberrypi"
```

## meta-raspberrypi/conf/layer.conf
```bitbake
# We have a conf and classes directory, append to BBPATH
BBPATH .= ":${LAYERDIR}"

# We have a recipes directory containing .bb and .bbappend files, add to BBFILES
BBFILES += "${LAYERDIR}/recipes*/*/*.bb \
            ${LAYERDIR}/recipes*/*/*.bbappend \
            ${LAYERDIR}/images/*.bb \
            ${LAYERDIR}/images/*.bbappend"

BBFILE_COLLECTIONS += "varnerized-raspberrypi"
BBFILE_PATTERN_varnerized-raspberrypi := "^${LAYERDIR}/"
BBFILE_PRIORITY_varnerized-raspberrypi = "11"


LAYERSERIES_COMPAT_varnerized-raspberrypi  = "gatesgarth"
LAYERDEPENDS_varnerized-raspberrypi = "raspberrypi core"
```

## meta-raspberrypi/wic/sdimage-raspberrypi-rooverlayfs.wks
```
# short-description: Create Raspberry Pi SD card image with dual rootfs, overlay partition, and swap.
# long-description: Creates a partitioned SD card image for use with
# Raspberry Pi. Boot files are located in the first vfat partition.

# 16gb sdhc card: - 2% free space (for wear leveling) - boot part - rootfs size - swap = overlay size.
# 16000 - 3276 - boot part - rootfs size * 2 - swap = overlay size
# 16384 - 3276 - 20 - rootfssize * 2 - 2048 = overlayfs
# 16384 - 3276 - 20 - 110 * 2 - 2048 = 10812, round down to 10240.

part /boot --source bootimg-partition --ondisk mmcblk0 --fstype=vfat --label boot --active --align 4096 --size 20
part / --source rootfs --ondisk mmcblk0 --fstype=ext4 --label roota --align 4096 --extra-space=0 --overhead-factor=1
part --source rootfs --ondisk mmcblk0 --fstype=ext4 --label rootb --align 4096 --extra-space=0 --overhead-factor=1
part swap --ondisk mmcblk0 --fstype=swap --label swap --align 4096 --size 2048
part --ondisk mmcblk0 --fstype=ext4 --label overlayfs --align 4096 --size 10240 --fsoptions=noatime
#put the overlay at the end of the disk so we can grow it.
```

## meta-rocketstand/conf/layer.conf
```bitbake
# We have a conf and classes directory, append to BBPATH
BBPATH .= ":${LAYERDIR}"

# We have a recipes directory containing .bb and .bbappend files, add to BBFILES
BBFILES += "${LAYERDIR}/recipes*/*/*.bb \
            ${LAYERDIR}/recipes*/*/*.bbappend \
            ${LAYERDIR}/images/*.bb \
            ${LAYERDIR}/images/*.bbappend"

BBFILE_COLLECTIONS += "varnerized-rocketstand"
BBFILE_PATTERN_varnerized-rocketstand := "^${LAYERDIR}/"
BBFILE_PRIORITY_varnerized-rocketstand = "10"


LAYERSERIES_COMPAT_varnerized-rocketstand  = "gatesgarth"
LAYERDEPENDS_varnerized-rocketstand = "varnerized-raspberrypi"
```
