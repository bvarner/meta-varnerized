## meta-klipper/conf/layer.conf
```bitbake
# meta-klipper - Klipper host and MCU build tooling
BBPATH .= ":${LAYERDIR}"

BBFILES += "${LAYERDIR}/recipes*/*/*.bb \
            ${LAYERDIR}/recipes*/*/*.bbappend \
            ${LAYERDIR}/images/*.bb \
            ${LAYERDIR}/images/*.bbappend"

BBFILE_COLLECTIONS += "meta-klipper"
BBFILE_PATTERN_meta-klipper := "^${LAYERDIR}/"
BBFILE_PRIORITY_meta-klipper = "9"

LAYERDEPENDS_meta-klipper = "core"
LAYERSERIES_COMPAT_meta-klipper = "kirkstone"
```
