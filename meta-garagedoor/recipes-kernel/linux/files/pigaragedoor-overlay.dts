/dts-v1/;
/plugin/;
#include <dt-bindings/pinctrl/bcm2835.h>
#include <dt-bindings/gpio/gpio.h>

/* Pigaragedoor DTS
Output GPIOS:
	relay_a: 17
	relay_b: 27

All outputs configured for push-pull, active low, internal pull-ups set high.

Input Pins (Open-Drain, internal pull HIGH:
	switch_a: 23
	switch_b: 24
*/

/ {
	compatible = "brcm,bcm2835", "brcm,bcm2708";

	fragment@0 {
		target = <&gpio>;
		__overlay__ {
			pinctrl-names = "default";
			pinctrl-0 = <&input_pins>;
			pinctrl-1 = <&relay_pins>;

			relay_pins: relay_pins {
				output-low;
				gpios = <17 (GPIO_ACTIVE_LOW | GPIO_PUSH_PULL | GPIO_PERSISTENT)>,
				        <27 (GPIO_ACTIVE_LOW | GPIO_PUSH_PULL | GPIO_PERSISTENT)>;
				brcm,pins = <17 27>;
				brcm,function = <
					BCM2835_FSEL_GPIO_OUT
					BCM2835_FSEL_GPIO_OUT
				>;
				brcm,pull = <
					BCM2835_PUD_UP
					BCM2835_PUD_UP
				>;
			};
			input_pins: input_pins {
				input;
				brcm,pins = <23 24>;
				brcm,function = <
					BCM2835_FSEL_GPIO_IN
					BCM2835_FSEL_GPIO_IN
				>;
				brcm,pull = <
					BCM2835_PUD_UP
					BCM2835_PUD_UP
				>;
			};
		};
	};
/*
	fragment@1 {
		target-path = "/";
		__overlay__ {
			pigaragedoor: pigaragedoor@0 {
				compatible = "garagedoor,pigaragedoor";
				
				pinctrl-names = "default";
				pinctrl-0 = <&relay_pins>;
				pinctrl-1 = <&input_pins>;
				
				relay-gpios = <&gpio 17 (GPIO_ACTIVE_LOW | GPIO_PUSH_PULL | GPIO_PERSISTENT)>, // relay_a
				              <&gpio 27 (GPIO_ACTIVE_LOW | GPIO_PUSH_PULL | GPIO_PERSISTENT)>; // relay_b
				              
				input-gpios = <&gpio 23 0>, // switch_a
				              <&gpio 24 0>; // switch_b
				
				status = "okay";
			};
		};
	};
*/
};
